#include "web_server.h"

#include <math.h>
#include <stdio.h>
#include <string.h>

#include "cJSON.h"
#include "communication/manual_control/manual_control.h"
#include "core/control_task.h"
#include "esp_http_server.h"
#include "esp_log.h"
#include "esp_timer.h"

#define WEB_SERVER_CORE          0
#define WEB_SERVER_STACK_SIZE    6144
#define COMMAND_BODY_MAX_BYTES   256
#define TELEMETRY_MAX_BYTES      1536

static const char *TAG = "web_server";
static httpd_handle_t server;
static esp_err_t last_status_error;
// Resolve the linker symbols generated by EMBED_TXTFILES for dashboard.html:
extern const char dashboard_start[] asm("_binary_dashboard_html_start");
extern const char dashboard_end[] asm("_binary_dashboard_html_end");

// Send a plain response with an explicit HTTP status:
static esp_err_t send_message(httpd_req_t *request, const char *status, const char *message) {
    httpd_resp_set_status(request, status);
    httpd_resp_set_type(request, "text/plain; charset=utf-8");
    httpd_resp_set_hdr(request, "Cache-Control", "no-store");
    return httpd_resp_send(request, message, HTTPD_RESP_USE_STRLEN);
}

// Deliver the original dashboard embedded in flash:
static esp_err_t handle_dashboard(httpd_req_t *request) {
    httpd_resp_set_type(request, "text/html; charset=utf-8");
    httpd_resp_set_hdr(request, "Cache-Control", "no-store");
    esp_err_t result = httpd_resp_send(request, dashboard_start, dashboard_end - dashboard_start - 1);
    if(result != ESP_OK) ESP_LOGD(TAG, "Dashboard page transmission failed: %s", esp_err_to_name(result));

    return result;
}
/*
EMBED_TXTFILES appends a null byte to the HTML. The linker symbols delimit that
entire buffer, so subtracting one sends only the page contents over HTTP.
*/

// Report elapsed time since the control task last consumed a sensor event:
static long long sensor_age_ms(int64_t now_us, int64_t updated_us, bool received) {
    if(!received) return -1;
    return (now_us - updated_us) / 1000;
}

// Format a status copy without holding the control mutex during network transmission:
static esp_err_t handle_telemetry(httpd_req_t *request) {
    control_status_t status;
    esp_err_t result = control_task_get_status(&status);
    // Log status failures only when they change, then report recovery once:
    if(result != ESP_OK) {
        if(result != last_status_error) ESP_LOGW(TAG, "Control status unavailable: %s", esp_err_to_name(result));
        last_status_error = result;
        return send_message(request, "503 Service Unavailable", "Control status unavailable");
    }
    if(last_status_error != ESP_OK) ESP_LOGI(TAG, "Control status available again");
    last_status_error = ESP_OK;

    // Prepare validity flags and display values from the copied control status:
    char response[TELEMETRY_MAX_BYTES];
    int64_t now_us = esp_timer_get_time();
    bool temperature_valid = status.temperature_received && status.temperature_valid && isfinite(status.temperature_c);
    bool level_valid = status.level_received && status.level_valid && isfinite(status.level_cm) && status.level_cm >= 0.0f;
    bool luminosity_valid = status.luminosity_received && status.luminosity_valid;
    int pump = status.fill_enabled ? 1 : status.drain_enabled ? 2 : 0;
    // Build the XML fields consumed by the dashboard in one bounded buffer:
    int length = snprintf(
        response,
        sizeof(response),
        "<?xml version=\"1.0\" encoding=\"UTF-8\"?>"
        "<telemetry><TEMP>%.2f</TEMP><DIST>%.2f</DIST><LUM>%d</LUM>"
        "<TEMP_VALID>%d</TEMP_VALID><DIST_VALID>%d</DIST_VALID><LUM_VALID>%d</LUM_VALID>"
        "<TEMP_AGE_MS>%lld</TEMP_AGE_MS><DIST_AGE_MS>%lld</DIST_AGE_MS><LUM_AGE_MS>%lld</LUM_AGE_MS>"
        "<PUMP>%d</PUMP><HEATER>%d</HEATER><STATE>%s</STATE><MANUAL>%d</MANUAL>"
        "<ACTUATOR_FAULT>%d</ACTUATOR_FAULT><OPERATION_TIMED_OUT>%d</OPERATION_TIMED_OUT>"
        "<LAST_COMMAND_ID>%lu</LAST_COMMAND_ID><LAST_COMMAND_RESULT>%d</LAST_COMMAND_RESULT>"
        "<LAST_COMMAND_ERROR>%s</LAST_COMMAND_ERROR></telemetry>",
        temperature_valid ? status.temperature_c : 0.0f,
        level_valid ? status.level_cm : 0.0f,
        luminosity_valid ? status.luminosity_raw : 0,
        temperature_valid,
        level_valid,
        luminosity_valid,
        sensor_age_ms(now_us, status.temperature_updated_us, status.temperature_received),
        sensor_age_ms(now_us, status.level_updated_us, status.level_received),
        sensor_age_ms(now_us, status.luminosity_updated_us, status.luminosity_received),
        pump,
        status.heater_enabled,
        state_machine_state_to_string(status.state),
        status.state == SYSTEM_STATE_MANUAL,
        status.actuator_fault,
        status.operation_timed_out,
        (unsigned long)status.last_command_id,
        status.last_command_result,
        esp_err_to_name(status.last_command_result)
    );
    if(length < 0 || length >= (int)sizeof(response)) {
        ESP_LOGE(TAG, "Telemetry formatting failed | required_bytes=%d capacity=%u", length, (unsigned int)sizeof(response));
        return send_message(request, "500 Internal Server Error", "Telemetry response too large");
    }

    httpd_resp_set_type(request, "application/xml; charset=utf-8");
    httpd_resp_set_hdr(request, "Cache-Control", "no-store");
    result = httpd_resp_send(request, response, length);
    if(result != ESP_OK) ESP_LOGD(TAG, "Telemetry transmission failed: %s", esp_err_to_name(result));

    return result;
}
/*
control_task_get_status() releases its mutex before XML formatting and socket
transmission, so slow HTTP clients do not hold the control status lock.
Invalid readings use numeric placeholders together with false validity flags;
the browser displays unavailable data instead of treating those zeros as readings.

Sensor age is measured since the control task consumed the latest event, not
since physical acquisition. Relay fields record successful software commands,
not physical actuator feedback; actuator faults make the dashboard show UNKNOWN.
snprintf() returns the full required length, allowing truncated XML to be rejected.
*/

// Read a bounded request body and reject truncated data or embedded null bytes:
static esp_err_t read_command_body(httpd_req_t *request, char *body, size_t capacity) {
    if(request->content_len == 0 || request->content_len >= capacity) {
        ESP_LOGW(TAG, "Command rejected | invalid body length=%lu", (unsigned long)request->content_len);
        send_message(request, "400 Bad Request", "Invalid command length");
        return ESP_FAIL;
    }

    // Require the JSON media type used by dashboard commands:
    char content_type[48];
    if(httpd_req_get_hdr_value_str(request, "Content-Type", content_type, sizeof(content_type)) != ESP_OK ||
       (strcmp(content_type, "application/json") != 0 && strcmp(content_type, "application/json; charset=utf-8") != 0)) {
        ESP_LOGW(TAG, "Command rejected | expected application/json");
        send_message(request, "415 Unsupported Media Type", "Expected application/json");
        return ESP_FAIL;
    }

    // Receive every declared body byte before parsing the request:
    size_t received = 0;
    while(received < request->content_len) {
        int count = httpd_req_recv(request, body + received, request->content_len - received);
        if(count <= 0) {
            ESP_LOGW(
                TAG,
                "Command body incomplete | received=%lu expected=%lu socket_result=%d",
                (unsigned long)received,
                (unsigned long)request->content_len,
                count
            );
            if(count == HTTPD_SOCK_ERR_TIMEOUT) httpd_resp_send_408(request);
            return ESP_FAIL;
        }
        received += count;
    }
    body[received] = '\0';
    if(memchr(body, '\0', received) != NULL) {
        ESP_LOGW(TAG, "Command rejected | embedded null byte in JSON body");
        send_message(request, "400 Bad Request", "Invalid JSON body");
        return ESP_FAIL;
    }

    return ESP_OK;
}
/*
The declared body length must leave room for a terminating null byte in the
fixed buffer. httpd_req_recv() may return only part of the body, so the loop
continues until content_len bytes arrive. A timeout or closed socket aborts it.

The appended terminator makes the buffer a C string. Embedded null bytes are
rejected so the JSON parser cannot accept a valid prefix while ignoring the
remaining body. On read failure the caller returns ESP_FAIL to close the session.
*/

// Distinguish queue acceptance from the execution result exposed in telemetry:
static esp_err_t send_command_result(httpd_req_t *request, esp_err_t result, uint32_t command_id) {
    if(result == ESP_ERR_INVALID_ARG) {
        ESP_LOGW(TAG, "Command rejected | invalid or unexpected parameters");
        return send_message(request, "400 Bad Request", "Invalid command parameters");
    }
    if(result != ESP_OK) return send_message(request, "503 Service Unavailable", "Command queue unavailable; request not accepted");

    char response[64];
    int length = snprintf(response, sizeof(response), "{\"accepted\":true,\"commandId\":%lu}", (unsigned long)command_id);
    httpd_resp_set_status(request, "202 Accepted");
    httpd_resp_set_type(request, "application/json");
    httpd_resp_set_hdr(request, "Cache-Control", "no-store");
    esp_err_t send_result = httpd_resp_send(request, response, length);
    if(send_result != ESP_OK) {
        ESP_LOGW(TAG, "Accepted command acknowledgement failed | id=%lu error=%s", (unsigned long)command_id, esp_err_to_name(send_result));
    }

    return send_result;
}
/*
HTTP 202 means the control queue accepted a copy of the request. It does not
mean a relay changed: the state machine still checks mode, sensors, and faults.
commandId lets the browser match that request to LAST_COMMAND_ID and inspect
LAST_COMMAND_RESULT in a later telemetry response.
*/

// Validate a mode or pump request before translating it into an internal command:
static esp_err_t handle_command(httpd_req_t *request) {
    char body[COMMAND_BODY_MAX_BYTES];
    if(read_command_body(request, body, sizeof(body)) != ESP_OK) return ESP_FAIL;

    // Parse a complete JSON object, rejecting non-whitespace data after it:
    cJSON *object = cJSON_ParseWithOpts(body, NULL, true);
    if(!cJSON_IsObject(object)) {
        ESP_LOGW(TAG, "Command rejected | malformed JSON or non-object root");
        cJSON_Delete(object);
        return send_message(request, "400 Bad Request", "Expected a JSON object");
    }

    // Validate the exact command fields before forwarding the request:
    uint32_t command_id = 0;
    esp_err_t result = ESP_ERR_INVALID_ARG;
    if(strcmp(request->uri, "/controlMode") == 0) {
        const cJSON *manual = cJSON_GetObjectItemCaseSensitive(object, "manual");
        if(cJSON_GetArraySize(object) == 1 && cJSON_IsBool(manual)) {
            result = manual_control_set_mode(cJSON_IsTrue(manual), &command_id);
        }
    }
    else {
        const cJSON *pump = cJSON_GetObjectItemCaseSensitive(object, "pumpId");
        const cJSON *enabled = cJSON_GetObjectItemCaseSensitive(object, "state");
        if(cJSON_GetArraySize(object) == 2 && cJSON_IsNumber(pump) &&
           (pump->valuedouble == 1.0 || pump->valuedouble == 2.0) && cJSON_IsBool(enabled)) {
            result = manual_control_set_pump(pump->valueint, cJSON_IsTrue(enabled), &command_id);
        }
    }
    cJSON_Delete(object);

    return send_command_result(request, result, command_id);
}
/*
The final true argument to cJSON_ParseWithOpts() requires the parsed value to
reach the string terminator after optional whitespace. Scalar and array roots
are rejected because commands must be objects.

For objects, cJSON_GetArraySize() counts members. That count, the required field
names, and strict boolean/number checks reject missing, extra, or duplicated
fields. Pump values must equal 1 or 2 before their integer representation is
used. The parsed object is released after the internal command has been copied.
*/

// Start one HTTP task for monitoring and commands on the communication core:
esp_err_t web_server_start(void) {
    if(server != NULL) {
        ESP_LOGW(TAG, "HTTP server start rejected | already running");
        return ESP_ERR_INVALID_STATE;
    }

    // Configure the communication task and bound waits on client sockets:
    httpd_config_t config = HTTPD_DEFAULT_CONFIG();
    config.core_id = WEB_SERVER_CORE;
    config.stack_size = WEB_SERVER_STACK_SIZE;
    config.max_open_sockets = 4;
    config.lru_purge_enable = true;
    config.recv_wait_timeout = 2;
    config.send_wait_timeout = 2;
    esp_err_t result = httpd_start(&server, &config);
    if(result != ESP_OK) {
        ESP_LOGE(TAG, "HTTP server startup failed: %s", esp_err_to_name(result));
        return result;
    }

    // Register page, telemetry, and command routes on the same HTTP task:
    const httpd_uri_t routes[] = {
        {.uri = "/", .method = HTTP_GET, .handler = handle_dashboard},
        {.uri = "/xml", .method = HTTP_GET, .handler = handle_telemetry},
        {.uri = "/controlMode", .method = HTTP_POST, .handler = handle_command},
        {.uri = "/controlPump", .method = HTTP_POST, .handler = handle_command}
    };
    for(size_t index = 0; index < sizeof(routes) / sizeof(routes[0]); index++) {
        result = httpd_register_uri_handler(server, &routes[index]);
        if(result != ESP_OK) {
            ESP_LOGE(TAG, "HTTP route registration failed | route=%s error=%s", routes[index].uri, esp_err_to_name(result));
            web_server_stop();
            return result;
        }
    }
    ESP_LOGI(TAG, "Dashboard HTTP server started on core %d", WEB_SERVER_CORE);

    return ESP_OK;
}
/*
httpd_start() creates the server task; this module does not need another task
for commands or telemetry. core_id places HTTP work on core 0, while socket
timeouts and LRU purging limit how long inactive clients occupy server resources.
If route registration fails, stopping the server releases the task and sockets
instead of leaving a partially configured dashboard running.
*/

// Release the HTTP task and its sockets:
esp_err_t web_server_stop(void) {
    if(server == NULL) return ESP_OK;

    esp_err_t result = httpd_stop(server);
    if(result == ESP_OK) {
        server = NULL;
        ESP_LOGI(TAG, "Dashboard HTTP server stopped");
    }
    else ESP_LOGE(TAG, "HTTP server shutdown failed: %s", esp_err_to_name(result));

    return result;
}
